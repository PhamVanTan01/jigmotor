/**
  ******************************************************************************
  * @file    gremsyMotor.c
  * @author  Gremsy Team
  * @version V2.0.0
  * @date    ${date}
  * @brief
  *
  ******************************************************************************
  * @Copyright
  * COPYRIGHT NOTICE: (c) ${year} Gremsy.
  * All rights reserved.
  *
  * The information contained herein is confidential
  * property of Company. The use, copying, transfer or
  * disclosure of such information is prohibited except
  * by express written agreement with Company.
  *
  ******************************************************************************
*/

/* Includes ------------------------------------------------------------------*/
#include "main.h"
#include "math.h"
#include "gremsyProfiles.h"
#include "gremsyMotor.h"
#include <gremsyEncoder.h>

/* Private typedef -----------------------------------------------------------*/
typedef struct
{
    uint16_t    motorOffset;
    int16_t     currentPos;
    float       kP, kI, kD;
    float       P, I, D;
    float       error, errorLast;
    float       outputPos;

}gremsyMotor_t;

/* Private define ------------------------------------------------------------*/
#define GREMSY_MOTOR_TIMER              htim1

/* Private macro -------------------------------------------------------------*/

/* Private variables ---------------------------------------------------------*/
extern TIM_HandleTypeDef htim1;
extern TIM_HandleTypeDef htim8;
gremsyMotor_t gremsyMotorPrivate;
const uint16_t motorSinTable[GREMSY_MOTOR_PWM_SIN_TABLE_SIZE] = 
{
//    1077 ,1078 ,1079 ,1080 ,1082 ,1083 ,1084 ,1085 ,1086 ,1087 ,1088 ,1089 ,1091 ,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1076
	1237, 1238, 1240, 1242, 1243, 1245, 1247, 1248, 1250, 1252, 1254, 1255,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 1235,
};

/* Private function prototypes -----------------------------------------------*/

/* Private functions ---------------------------------------------------------*/

/** @brief      ham limit integer
    @param[in]
    count: gia tri
    threshold: nguong gia tri
    @return     none
*/
uint32_t limit_integer(uint32_t count, uint32_t threshold)
{
    uint32_t so_nguyen = count/threshold;
    uint32_t offset = count - so_nguyen*threshold;

    return offset;
}

void gremsyMotorEnable(void)
{
    HAL_GPIO_WritePin(MOTOR_ENA_GPIO_Port, MOTOR_ENA_Pin, GPIO_PIN_SET);
}

void gremsyMotorDisable(void)
{
    HAL_GPIO_WritePin(MOTOR_ENA_GPIO_Port, MOTOR_ENA_Pin, GPIO_PIN_RESET);
}

void gremsyMotorInit(void)
{
    /// Init cac PWM cho motor
    if(HAL_TIM_PWM_Start(&htim1, TIM_CHANNEL_3) != HAL_OK)
    {
        /* Starting Error*/
        Error_Handler();
    }

    if(HAL_TIM_PWM_Start(&htim1, TIM_CHANNEL_2) != HAL_OK)
    {
        /* Starting Error*/
        Error_Handler();
    }

    if(HAL_TIM_PWM_Start(&htim1, TIM_CHANNEL_1) != HAL_OK)
    {
        /* Starting Error*/
        Error_Handler();
    }
}

void gremsyMotorSetPWM(uint16_t pwm1, uint16_t pwm2, uint16_t pwm3)
{
    __HAL_TIM_SetCompare(&htim1, TIM_CHANNEL_1, pwm1);
    __HAL_TIM_SetCompare(&htim1, TIM_CHANNEL_2, pwm2);
    __HAL_TIM_SetCompare(&htim1, TIM_CHANNEL_3, pwm3);
}

void gremsyMotorSetOffset(uint16_t motorOffset)
{
	gremsyMotorPrivate.motorOffset = motorOffset;
}

void gremsyMotorMovePos(uint16_t pos, float power)
{
    int32_t pos_step        = pos;
    int32_t count_per_polse = MOTOR_COUNT_PER_POLSE;
    int32_t count_per_round = MOTOR_COUNT_PER_ROUND;
    int32_t a_polse_offset  = MOTOR_A_POLSE_OFFSET;
    int32_t b_polse_offset  = MOTOR_B_POLSE_OFFSET;
    int32_t c_polse_offset  = MOTOR_C_POLSE_OFFSET;
    int32_t sintable_count  = GREMSY_MOTOR_PWM_SIN_TABLE_SIZE;

    uint32_t stepA = 0;
    uint32_t stepB = 0;
    uint32_t stepC = 0;

    /// gioi han nho hon 0
    if(pos_step < 0)
    {
        pos_step = pos_step + count_per_round;
    }

    /// gioi han trong gia tri mang sin
    pos_step = limit_integer(pos_step, count_per_polse);

    /// Calculate step of polse
    stepA = pos_step + a_polse_offset;
    stepB = pos_step + b_polse_offset;
    stepC = pos_step + c_polse_offset;

    /// Limit phase B
    if(stepB >= count_per_polse)
    {
        stepB = stepB - count_per_polse;
    }

    /// Limit phase C
    if(stepC >= count_per_polse)
    {
        stepC = stepC - count_per_polse;
    }

    /// Limit phase power
    if(power > 1)
    {
        power = 1;
    }
    else if(power < 0)
    {
        power = 0;
    }

    /// Output PWM
    gremsyMotorSetPWM(  motorSinTable[stepA*sintable_count/count_per_polse]*power,
                        motorSinTable[stepB*sintable_count/count_per_polse]*power,
                        motorSinTable[stepC*sintable_count/count_per_polse]*power);
}

float gremsyMotorMoveAngle(float angle)
{
    /// Hieu chinh kp, ki, kd de di chuyen vi tri
    gremsyMotorPrivate.kP = MOTOR_MOVE_POS_KP;
    gremsyMotorPrivate.kI = MOTOR_MOVE_POS_KI;
    gremsyMotorPrivate.kD = MOTOR_MOVE_POS_KD;

    gremsyMotorPrivate.error = gremsyEncoderReadAngle() - angle;
    gremsyMotorPrivate.P = gremsyMotorPrivate.kP*gremsyMotorPrivate.error;
    gremsyMotorPrivate.I += gremsyMotorPrivate.kI*gremsyMotorPrivate.error;
    if(fabs(gremsyMotorPrivate.I) > MOTOR_MOVE_POS_I_LIMIT)
    {
        gremsyMotorPrivate.I = 0;
    }
    gremsyMotorPrivate.D = gremsyMotorPrivate.kD*(gremsyMotorPrivate.error - gremsyMotorPrivate.errorLast);
    gremsyMotorPrivate.errorLast = gremsyMotorPrivate.error;

    /// calcultate output
    gremsyMotorPrivate.outputPos = gremsyMotorPrivate.P + gremsyMotorPrivate.I + gremsyMotorPrivate.D;

    /// Limit
    if(gremsyMotorPrivate.outputPos > MOTOR_MOVE_POS_MAX) gremsyMotorPrivate.outputPos = MOTOR_MOVE_POS_MAX;
    if(gremsyMotorPrivate.outputPos < -MOTOR_MOVE_POS_MAX) gremsyMotorPrivate.outputPos = -MOTOR_MOVE_POS_MAX;
    gremsyMotorPrivate.currentPos -= gremsyMotorPrivate.outputPos;

    /// Move motor
    gremsyMotorMovePos(gremsyMotorPrivate.currentPos, 1.0f);

    // Return error
    return gremsyMotorPrivate.error;
}

void gremsyMotorMoveSpeed(int16_t speed, float power)
{

    int32_t polse_num       = 28/2;
    int32_t count_per_polse = 65536/polse_num;
    int32_t b_polse_offset  = count_per_polse/3;

    int32_t  ratio           =  2;
    int32_t  count_per_round =  count_per_polse*polse_num;
    int32_t  encoder_count_max   =  65536;

    ///
    int32_t  max             =  b_polse_offset*ratio*2/3;
    int32_t  min             =  -max;

    uint16_t count = gremsyEncoderReadRaw()*count_per_round/encoder_count_max;

    int32_t  sp;
    int32_t  pos;

    sp = speed/ratio;

    /// gioi han gia tri speed
    if(sp > max)
    {
        sp = max;
    }
    else if(sp < min)
    {
        sp = min;
    }

    /// tinh vi tri tiep theo cua dong co dua vao encoder
    pos = count - gremsyMotorPrivate.motorOffset + sp;

    /// dieu khien vi tri ket hop encoder cho motor
    gremsyMotorMovePos(pos, power);
}

void gremsyMotorPidSpeed(int16_t speed)
{

}

void gremsyMotorProcess(void)
{

}

/************************ (C) COPYRIGHT GREMSY *****END OF FILE****************/
